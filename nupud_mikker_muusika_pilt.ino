#include <Adafruit_NeoPixel.h>
#include <avr/pgmspace.h>
#include "pitches.h"

#define BUZZER_PIN 8       // Buzzer ühendatud pinni
#define NUM_LEDS 256       // 16x16 maatriks
#define DATA_PIN 9         // LED maatriks ühendatud pinni
#define BUTTON_1_PIN 7       
#define BUTTON_2_PIN 6 

int buzzer = 8;
int buttonState = 0;       // Nupu oleku jälgimine

const uint32_t colors_1989[NUM_LEDS] PROGMEM = {
0xFF0000,0xFF0000,0xFF0000,0xFF0000,0xFF0000,0xFF0000,0xFF0000,0xFF0000,0xFF0000,0xFF0000,0xFF0000,0xFF0000,0xFF0000,0xFF0000,0xFF0000,0xFF0000,
0xFF0000,0xFFFFF,0xFF0000,0xFFFFF,0xFFFFF,0xFFFFF,0xFFFFF,0xFF0000,0xFFFFF,0xFFFFF,0xFFFFF,0xFF0000,0xFFFFF,0xFFFFF,0xFFFFF,0xFFFFF,
0xFFFFF,0xFF0000,0xFF0000,0xFFFFF,0xFF0000,0xFFFFF,0xFF0000,0xFFFFF,0xFF0000,0xFFFFF,0xFF0000,0xFF0000,0xFFFFF,0xFF0000,0xFFFFF,0xFF0000,
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0xFF0000,0xFF0000,0xFF0000,0xFF0000,0xFF0000,0xFF0000,0xFF0000,0xFF0000,0xFF0000,0xFF0000,0xFF0000,0xFF0000,0xFF0000,0xFF0000,0xFF0000,0xFF0000
};


const uint32_t colors_red_album[NUM_LEDS] PROGMEM = {
0xdFF0000, 0xdFF0000, 0xdFF0000, 0xdFF0000, 0xdFF0000, 0xdFF0000, 0xdFF0000, 0xdFF0000, 0xdFF0000, 0xdFF0000, 0xdFF0000, 0xdFF0000, 0xdFF0000, 0xdFF0000, 0xdFF0000, 0xdFF0000,
0xdFF0000, 0xdFF0000, 0xdFF0000, 0xdFF0000, 0xdFF0000, 0xdFF0000, 0xdFF0000, 0xdFFD500, 0xdFFD500, 0xdFF0000, 0xdFF0000, 0xdFF0000, 0xdFF0000, 0xdFF0000, 0xdFF0000, 0xdFF0000,
0xdFF0000, 0xdFF0000, 0xdFF0000, 0xdFF0000, 0xdFF0000, 0xdFF0000, 0xdFF0000, 0xdFFD500, 0xdFFD500, 0xdFF0000, 0xdFF0000, 0xdFF0000, 0xdFF0000, 0xdFF0000, 0xdFF0000, 0xdFF0000,
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0xdFF0000, 0xdFF0000, 0xdFF0000, 0xdFF0000, 0xdFF0000, 0xdFF0000, 0xdFF0000, 0xdFF0000, 0xdFF0000, 0xdFF0000, 0xdFF0000, 0xdFF0000, 0xdFF0000, 0xdFF0000, 0xdFF0000, 0xdFF0000

};

// Aktiivne massiiv (vaikimisi)
const uint32_t* activeColors = nullptr;


Adafruit_NeoPixel strip = Adafruit_NeoPixel(NUM_LEDS, DATA_PIN, NEO_GRB + NEO_KHZ800);


// Meloodia nootide ja kestuste definitsioonid
int melody_red[] = {
  NOTE_G4, 4, NOTE_E4, 8, NOTE_D4, 8, NOTE_C4, 4, NOTE_D4, 4, NOTE_E4, 8, NOTE_G4, 8, NOTE_A4, 4,
  NOTE_B4, 4, NOTE_A4, 8, NOTE_G4, 8, NOTE_F4, 4, NOTE_E4, 4, NOTE_D4, 8, NOTE_C4, 8, NOTE_G4, 4,
  NOTE_A4, 8, NOTE_B4, 8, NOTE_C5, 4, NOTE_D5, 4, NOTE_B4, 8, NOTE_A4, 8, NOTE_G4, 4,
  NOTE_A4, 4, NOTE_G4, 8, NOTE_F4, 8, NOTE_E4, 4, NOTE_D4, 4, NOTE_C4, 8, NOTE_D4, 8,
  NOTE_E4, 4, NOTE_F4, 4, NOTE_E4, 8, NOTE_D4, 8, NOTE_C4, 4, NOTE_D4, 4, NOTE_G4, 8,
  NOTE_F4, 8, NOTE_E4, 4, NOTE_D4, 4, NOTE_C4, 8, NOTE_D4, 8, NOTE_E4, 4, NOTE_G4, 4,
  NOTE_A4, 8, NOTE_B4, 8, NOTE_C5, 4, NOTE_D5, 4, NOTE_C5, 8, NOTE_B4, 8, NOTE_A4, 4
};

int melody_1989[] = {
  NOTE_E4, 8, NOTE_G4, 8, NOTE_A4, 4, NOTE_B4, 8, NOTE_A4, 8, NOTE_G4, 4,
  NOTE_E4, 8, NOTE_G4, 8, NOTE_A4, 4, NOTE_B4, 8, NOTE_C5, 8, NOTE_D5, 4,
  NOTE_E4, 8, NOTE_G4, 8, NOTE_A4, 4, NOTE_B4, 8, NOTE_C5, 8, NOTE_D5, 4
};


int tempo = 100; // kiirus BPM
int wholenote = (60000 * 4) / tempo; // täisnoodi kestus ms



void setup() {
  pinMode(BUTTON_1_PIN, INPUT_PULLUP); // Esimene nupp
  pinMode(BUTTON_2_PIN, INPUT_PULLUP); // Teine nupp
  pinMode(BUZZER_PIN, OUTPUT);
  strip.begin();
  strip.setBrightness(2);
  strip.show(); // Alguses kustutatud LED-d
}

void playMelody(int melody[], int size) {
  int notes = size / 2; // Arvuta nootide arv
  for (int thisNote = 0; thisNote < size; thisNote += 2) { // Iterateeri nootide paaride vahel
    int noteDuration = (wholenote) / melody[thisNote + 1];
    tone(BUZZER_PIN, melody[thisNote], noteDuration * 0.9);
    delay(noteDuration);
    noTone(BUZZER_PIN);
  }
}

void showLEDPattern() {
  for (int i = 0; i < NUM_LEDS; i++) {
    uint32_t color = pgm_read_dword(&activeColors[i]); // Loeb aktiivset massiivi
    strip.setPixelColor(i, color);
  }
  strip.show(); // Uuenda LED-id
}

void loop() {

  if (digitalRead(BUTTON_1_PIN) == LOW) { // Kui nuppu vajutatakse (LOW, sest pull-up takisti)
    activeColors = colors_red_album;
    showLEDPattern();
    playMelody(melody_red, sizeof(melody_red) / sizeof(melody_red[0]));
    delay(1000);            // Lühike paus
  }

  if (digitalRead(BUTTON_2_PIN) == LOW) { // Teine nupp
    activeColors = colors_1989; // Valib esimese massiivi
    showLEDPattern();
    playMelody(melody_1989, sizeof(melody_1989) / sizeof(melody_1989[0]));
    delay(1000);
  }
}

