#include <Adafruit_NeoPixel.h>
#include <avr/pgmspace.h>

#define BUZZER_PIN 8       // Buzzer ühendatud pinni
#define NUM_LEDS 256       // 16x16 maatriks
#define DATA_PIN 9         // LED maatriks ühendatud pinni
#define BUTTON_0_PIN 2
#define BUTTON_1_PIN 3       
#define BUTTON_2_PIN 4 
#define BUTTON_3_PIN 5
#define BUTTON_4_PIN 6
#define BUTTON_5_PIN 7

const int micPin = A0; // Mikrofoni sisendpinn
int buttonState = 0;   // Nupu oleku jälgimine

// BPM konstandid
const int MIN_BPM = 40;
const int MAX_BPM = 240;
const int BPM_THRESHOLD = 270;
const int MIN_INTERVAL_BETWEEN_BEATS = 300; // millisekundites

// Dünaamiline BPM arvutamine
const int BEAT_BUFFER_SIZE = 10;
unsigned long beatBuffer[BEAT_BUFFER_SIZE];
int beatIndex = 0;
int beatCount = 0;


const uint32_t colors_1989[NUM_LEDS] PROGMEM = {
0xFFFFF,0xFFFFF,0xFFFFF,0xFFFFF,0xFFFFF,0xFFFFF,0xFFFFF,0xFFFFF,0xFFFFF,0xFFFFF,0xFFFFF,0xFFFFF,0xFFFFF,0xFFFFF,0xFFFFF,0xFFFFF,
0xFFFFF,0xFF0000,0xFFFFF,0xFF0000,0xFF0000,0xFF0000,0xFF0000,0xFFFFF,0xFF0000,0xFF0000,0xFF0000,0xFFFFF,0xFF0000,0xFF0000,0xFF0000,0xFF0000,
0xFF0000,0xFFFFF,0xFFFFF,0xFF0000,0xFFFFF,0xFF0000,0xFFFFF,0xFF0000,0xFFFFF,0xFF0000,0xFFFFF,0xFFFFF,0xFF0000,0xFFFFF,0xFF0000,0xFFFFF,
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0xFFFFF,0xFFFFF,0xFFFFF,0xFFFFF,0xFFFFF,0xFFFFF,0xFFFFF,0xFFFFF,0xFFFFF,0xFFFFF,0xFFFFF,0xFFFFF,0xFFFFF,0xFFFFF,0xFFFFF,0xFFFFF
};

const uint32_t colors_butterfly[NUM_LEDS] PROGMEM= {
0x00000,0x00000,0x00000,0x00000,0x00000,0x00000,0x00000,0x00000,0x00000,0x00000,0x00000,0x00000,0x00000,0x00000,0x00000,0x00000,
0x00000,0x00000,0x00000,0x00000,0x00000,0xa8e61d,0x00000,0x00000,0x00000,0x00000,0xa8e61d,0x00000,0x00000,0x00000,0x00000,0x00000,
0x00000,0x00000,0xff00ec,0xff00ec,0x00000,0x00000,0xa8e61d,0x00000,0x00000,0xa8e61d,0x00000,0x00000,0xff00ec,0xff00ec,0x00000,0x00000,
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0x00000,0x00000,0x00000,0x00000,0x00000,0x00000,0x00000,0x00000,0x00000,0x00000,0x00000,0x00000,0x00000,0x00000,0x00000,0x00000};


const uint32_t colors_red_album[NUM_LEDS] PROGMEM = {
0xdFF0000, 0xdFF0000, 0xdFF0000, 0xdFF0000, 0xdFF0000, 0xdFF0000, 0xdFF0000, 0xdFF0000, 0xdFF0000, 0xdFF0000, 0xdFF0000, 0xdFF0000, 0xdFF0000, 0xdFF0000, 0xdFF0000, 0xdFF0000,
0xdFF0000, 0xdFF0000, 0xdFF0000, 0xdFF0000, 0xdFF0000, 0xdFF0000, 0xdFF0000, 0xdFFD500, 0xdFFD500, 0xdFF0000, 0xdFF0000, 0xdFF0000, 0xdFF0000, 0xdFF0000, 0xdFF0000, 0xdFF0000,
0xdFF0000, 0xdFF0000, 0xdFF0000, 0xdFF0000, 0xdFF0000, 0xdFF0000, 0xdFF0000, 0xdFFD500, 0xdFFD500, 0xdFF0000, 0xdFF0000, 0xdFF0000, 0xdFF0000, 0xdFF0000, 0xdFF0000, 0xdFF0000,
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0xdFF0000, 0xdFF0000, 0xdFF0000, 0xdFF0000, 0xdFF0000, 0xdFF0000, 0xdFF0000, 0xdFF0000, 0xdFF0000, 0xdFF0000, 0xdFF0000, 0xdFF0000, 0xdFF0000, 0xdFF0000, 0xdFF0000, 0xdFF0000

};


const uint32_t colors_fearless[NUM_LEDS] PROGMEM = {
0xffca00, 0xffca00, 0xffca00, 0xffca00, 0xffca00, 0xffca00, 0xffca00, 0xffca00, 0xffca00, 0xffca00, 0xffca00, 0xffca00, 0xffca00, 0xffca00, 0xffca00, 0xffca00,
0xffca00, 0xffca00, 0xffca00, 0xffca00, 0xffca00, 0xffca00, 0xffca00, 0xffca00, 0xffca00, 0xffca00, 0xffca00, 0xffca00, 0xffca00, 0xffca00, 0xffca00, 0xffca00,
0xffca00, 0xffca00, 0xffca00, 0xffca00, 0xffca00, 0xffca00, 0xffca00, 0xffca00, 0xffca00, 0xffca00, 0xffca00, 0xffca00, 0xffca00, 0xffca00, 0xffca00, 0xffca00,
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0xffca00, 0xffca00, 0xffca00, 0xffca00, 0xffca00, 0xffca00, 0xffca00, 0xffca00, 0xffca00, 0xffca00, 0xffca00, 0xffca00, 0xffca00, 0xffca00, 0xffca00, 0xffca00
};

const uint32_t colors_heart[NUM_LEDS] PROGMEM = {
 0xff00c8, 0xff00c8, 0xff00c8, 0xff00c8, 0xff00c8, 0xff00c8, 0xff00c8, 0xff00c8, 0xff00c8, 0xff00c8, 0xff00c8, 0xff00c8, 0xff00c8, 0xff00c8, 0xff00c8, 0xff00c8,
0xff00c8, 0xff00c8, 0xff00c8, 0xff00c8, 0xff00c8, 0xff00c8, 0xff00c8, 0xff00c8, 0xff00c8, 0xff00c8, 0xff00c8, 0xff00c8, 0xff00c8, 0xff00c8, 0xff00c8, 0xff00c8,
0xff00c8, 0xff00c8, 0xff00c8, 0x00b7ef, 0x00b7ef, 0x00b7ef, 0xff00c8, 0xff00c8, 0xff00c8, 0xff00c8, 0x00b7ef, 0x00b7ef, 0x00b7ef, 0xff00c8, 0xff00c8, 0xff00c8,
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0xff00c8, 0xff00c8, 0xff00c8, 0xff00c8, 0xff00c8, 0xff00c8, 0xff00c8, 0xff00c8, 0xff00c8, 0xff00c8, 0xff00c8, 0xff00c8, 0xff00c8, 0xff00c8, 0xff00c8, 0xff00c8

};


Adafruit_NeoPixel strip = Adafruit_NeoPixel(NUM_LEDS, DATA_PIN, NEO_GRB + NEO_KHZ800);

const uint32_t* activeColors = nullptr;
int currentBPM = 0;
unsigned long lastBeatTime = 0;
unsigned long currentTime = 0;

void setup() {
  // Nuppude seadistamine
  pinMode(BUTTON_0_PIN, INPUT_PULLUP);
  pinMode(BUTTON_1_PIN, INPUT_PULLUP);
  pinMode(BUTTON_2_PIN, INPUT_PULLUP);
  pinMode(BUTTON_3_PIN, INPUT_PULLUP);
  pinMode(BUTTON_4_PIN, INPUT_PULLUP);
  pinMode(BUTTON_5_PIN, INPUT_PULLUP);
  
  // Mikrofoni pin sisendiks
  pinMode(micPin, INPUT);

  // Buzzer väljundiks
  pinMode(BUZZER_PIN, OUTPUT);

  // LED-riba inizialiseerimine
  strip.begin();
  strip.setBrightness(3);
  strip.show(); // Alguses kustutatud LED-d

  // Silumine
  Serial.begin(9600);
}

// Filtreerib BPM-i lubatud vahemikku
int filterBPM(int rawBPM) {
    if (rawBPM < MIN_BPM) return 0;
    if (rawBPM > MAX_BPM) return MAX_BPM;
    return rawBPM;
}

// Kustutab kõik LED-id
void clearLEDs() {
  for (int i = 0; i < strip.numPixels(); i++) {
    strip.setPixelColor(i, 0);
  }
  strip.show();
}

// Näitab LED-mustrit BPM-i järgi
void showLEDPatternWithBPM(int bpm) {
    if (bpm > 0 && activeColors != nullptr) {
        int delayTime = 60000 / bpm; // Arvuta viivitus millisekundites
        
        // Näita LED-mustrit
        for (int i = 0; i < NUM_LEDS; i++) {
            uint32_t color = pgm_read_dword(&activeColors[i]);
            strip.setPixelColor(i, color);
        }
        
        strip.show();
        delay(delayTime / 2);
        
        clearLEDs();
        delay(delayTime / 2);
    }
}

int buttonPressed = 0;

void loop() {
    // Loe mikrofoni sisend
    int micValue = analogRead(micPin);
    currentTime = millis();

    // BPM arvutamine
    if (micValue > BPM_THRESHOLD && 
        (currentTime - lastBeatTime > MIN_INTERVAL_BETWEEN_BEATS)) {
        
        unsigned long interval = currentTime - lastBeatTime;
        int rawBPM = 60000 / interval;
        
        // Filtreeri BPM
        currentBPM = filterBPM(rawBPM);
        
        lastBeatTime = currentTime;

        // Väljasta silumisel
        Serial.print("Detected BPM: ");
        Serial.println(currentBPM);
    }

    // Nuppude kontroll mustrivahetuseks
    if (digitalRead(BUTTON_0_PIN) == LOW) {
        clearLEDs();
    }
    
    if (digitalRead(BUTTON_1_PIN) == LOW) {
        activeColors = colors_red_album;  
        showLEDPatternWithBPM(currentBPM);
    }

    if (digitalRead(BUTTON_2_PIN) == LOW) {
        activeColors = colors_1989;
        showLEDPatternWithBPM(currentBPM);
    }

    if (digitalRead(BUTTON_3_PIN) == LOW) {
        activeColors = colors_butterfly;
        
        showLEDPatternWithBPM(currentBPM);
    }

    if (digitalRead(BUTTON_4_PIN) == LOW) {
        activeColors = colors_fearless;
        
        showLEDPatternWithBPM(currentBPM);
    }

    if (digitalRead(BUTTON_5_PIN) == LOW) {
        activeColors = colors_heart;
        
        showLEDPatternWithBPM(currentBPM);
    }

    delay(0.1);
}

// Abifunktsioon BPM-i aktiveerimiseks
void activateBPMMode(int bpm) {
    if (bpm > 0) {
        Serial.print("Activated BPM Mode: ");
        Serial.println(bpm);
    }
}
